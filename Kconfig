## Kconfig
```kconfig
DT_COMPAT_ZMK_ARBITRARY_SPLIT_DATA_CHANNEL := zmk,arbitrary-split-data-channel
config ZMK_ARBITRARY_SPLIT_DATA_CHANNEL
    bool
    default $(dt_compat_enabled,$(DT_COMPAT_ZMK_ARBITRARY_SPLIT_DATA_CHANNEL))

config ZMK_ARBITRARY_SPLIT_DATA_CHANNEL_TX_QUEUE_SIZE
    int "Max number of data events to queue when sending"
    default 5

config ZMK_ARBITRARY_SPLIT_DATA_CHANNEL_RX_QUEUE_SIZE
    int "Max number of data events to queue when receiving"
    default 5

config ZMK_BT_ASDC_L2CAP_PSM
    hex "L2CAP PSM for Arbitrary Split Data Channel"
    default 0x0080

config BT_L2CAP_DYNAMIC_CHANNEL
    bool
    default y
```

## dts/bindings/zmk,arbitrary-split-data-channel.yaml
```yaml
description: |
  Allows defining arbitrary split data channel

compatible: "zmk,arbitrary-split-data-channel"

properties:
  channel-id:
    type: int
    required: true
    description: the id of this data channel, an integer.
```

## example_consumer/Kconfig
```kconfig
DT_COMPAT_ZMK_ARBITRARY_SPLIT_DATA_CHANNEL_CONSUMER := zmk,arbitrary-split-data-channel-consumer
config ZMK_ARBITRARY_SPLIT_DATA_CHANNEL_CONSUMER
		bool
		default $(dt_compat_enabled,$(DT_COMPAT_ZMK_ARBITRARY_SPLIT_DATA_CHANNEL_CONSUMER))

config ZMK_ASDC_MAX_CHANNELS
    int "The maximum number of arbitrary split data channels supported by one consumer"
    default 2
```

## example_consumer/dts/bindings/zmk,arbitrary-split-data-channel-consumer.yaml
```yaml
description: |
  Allows defining arbitrary split data channel consumer

compatible: "zmk,arbitrary-split-data-channel-consumer"

properties:
  asdc-channels:
    type: phandles
    required: true
    description: The asdc channel to use.
```
